## components/message/Kconfig.projbuild
```kconfig
menu "Message Configuration"

    config MSG_LOG_LEVEL
        int "Message LOG LEVEL"
        range 0	5
        default 2
        help
        	Set LOG Level for MESSAGE module
        	0=None
        	1=Error
        	2=Warn
        	3=Info
        	4=Debug
        	5=Verbose

    config MAX_PAYLOAD
        int "May payload length"
        range 64 128
        default 96
        help
            Maximum message payload bytes.
    
    config MAX_RAW
        int "May Raw Data Bytes"
        range 162 256
        default 220
        help
            Maximum message payload bytes.

    config N_MSG
        int "Pre-allocated messages"
        range 0 16
        default 16
        help
            Number of allocated messages.
    
endmenu
```
